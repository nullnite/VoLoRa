## boards/volora/Kconfig.defconfig
```kconfig
if BOARD_VOLORA

config BOARD_VOLORA
	select USE_DT_CODE_PARTITION if BOARD_VOLORA_NRF5340_CPUAPP

endif # BOARD_VOLORA
```

## boards/volora/Kconfig.volora
```kconfig
config BOARD_VOLORA
	select SOC_NRF5340_CPUAPP_QKAA if BOARD_VOLORA_NRF5340_CPUAPP
```

## boards/volora/board.yml
```yaml
board:
  name: volora
  full_name: VoLoRa
  vendor: custom
  socs:
  - name: nrf5340
```

## boards/volora/volora_nrf5340_cpuapp_defconfig
```kconfig
CONFIG_ARM_MPU=y
CONFIG_ARM_TRUSTZONE_M=y
CONFIG_GPIO=y
CONFIG_SERIAL=y
CONFIG_CONSOLE=y
CONFIG_UART_CONSOLE=y
CONFIG_CLOCK_CONTROL_NRF_K32SRC_RC=y
CONFIG_CLOCK_CONTROL_NRF_K32SRC_RC_CALIBRATION=y
```
